## Documentation/devicetree/bindings/riscv/bouffalolab.yaml
```yaml
# SPDX-License-Identifier: (GPL-2.0-only OR BSD-2-Clause)
%YAML 1.2
---
$id: http://devicetree.org/schemas/riscv/bouffalolab.yaml#
$schema: http://devicetree.org/meta-schemas/core.yaml#

title: Bouffalo Lab Technology SoC-based boards

maintainers:
  - Jisheng Zhang <jszhang@kernel.org>

description:
  Bouffalo Lab Technology SoC-based boards

properties:
  $nodename:
    const: '/'
  compatible:
    oneOf:
      - description: Sipeed M1s SoM:
        items:
          - const: sipeed,m1s
          - const: bouffalolab,bl808

      - description: Carrier boards for the Sipeed M1s SoM:
        items:
          - enum:
              - sipeed,m1s-dock
          - const: sipeed,m1s
          - const: bouffalolab,bl808

additionalProperties: true

...
```

## Documentation/devicetree/bindings/serial/bouffalolab,uart.yaml
```yaml
# SPDX-License-Identifier: (GPL-2.0-only OR BSD-2-Clause)
# Copyright (C) 2022 Jisheng Zhang <jszhang@kernel.org>
%YAML 1.2
---
$id: http://devicetree.org/schemas/serial/bouffalolab,uart.yaml#
$schema: http://devicetree.org/meta-schemas/core.yaml#

title: Bouffalolab UART Controller

maintainers:
  - Jisheng Zhang <jszhang@kernel.org>

allOf:
  - $ref: serial.yaml#

properties:
  compatible:
    const: bouffalolab,bl808-uart

  reg:
    maxItems: 1

  interrupts:
    maxItems: 1

  clocks:
    maxItems: 1

required:
  - compatible
  - reg
  - interrupts
  - clocks

additionalProperties: false

examples:
  - |
    #include <dt-bindings/interrupt-controller/irq.h>

    uart0: serial@30002000 {
        compatible = "bouffalolab,bl808-uart";
        reg = <0x30002000 0x1000>;
        interrupts = <53 IRQ_TYPE_LEVEL_HIGH>;
        clocks = <&xtal>;
    };
...
```
